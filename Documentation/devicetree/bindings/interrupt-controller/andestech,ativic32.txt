## Documentation/devicetree/bindings/interrupt-controller/andestech,ativic32.txt
```
* Andestech Internal Vector Interrupt Controller

The Internal Vector Interrupt Controller (IVIC) is a basic interrupt controller
suitable for a simpler SoC platform not requiring a more sophisticated and
bigger External Vector Interrupt Controller.


Main node required properties:

- compatible : should at least contain  "andestech,ativic32".
- interrupt-parent: Empty for the interrupt controller itself
- interrupt-controller : Identifies the node as an interrupt controller
- #interrupt-cells: The number of cells to define the interrupts. Should be 2.
	The first cell is the IRQ number
	The second cell is used to specify mode:
		1 = low-to-high edge triggered
		2 = high-to-low edge triggered
		4 = active high level-sensitive
		8 = active low level-sensitive
		Default for internal sources should be set to 4 (active high).

Examples:
	intc: interrupt-controller {
		compatible = "andestech,ativic32";
		#interrupt-cells = <2>;
		interrupt-controller;
	};
```

## Documentation/devicetree/bindings/nds32/cpus.txt
```
* Andestech Processor Binding

This binding specifies what properties must be available in the device tree
representation of a Andestech Processor Core, which is the root node in the
tree.

Required properties:

	- compatible:
		Usage: required
		Value type: <string>
		Definition: should be one of:
			"andestech,n13"
			"andestech,n15"
			"andestech,d15"
			"andestech,n10"
			"andestech,d10"
			"andestech,nds32v3"
	- device_type
		Usage: required
		Value type: <string>
		Definition: must be "cpu"
	- reg: Contains CPU index.
	- clock-frequency: Contains the clock frequency for CPU, in Hz.

* Examples

/ {
	cpus {
		cpu@0 {
			device_type = "cpu";
			compatible = "andestech,n13", "andestech,nds32v3";
			reg = <0x0>;
			clock-frequency = <60000000>
		};
	};
};
```

## arch/nds32/Kconfig
```kconfig
#
# For a description of the syntax of this configuration file,
# see Documentation/kbuild/kconfig-language.txt.
#

config NDS32
        def_bool y
	select ARCH_HAS_RAW_COPY_USER
	select ARCH_WANT_FRAME_POINTERS if FTRACE
	select ARCH_WANT_IPC_PARSE_VERSION
	select CLKSRC_MMIO
	select CLONE_BACKWARDS
	select TIMER_OF
	select FRAME_POINTER
	select GENERIC_ATOMIC64
	select GENERIC_CPU_DEVICES
	select GENERIC_CLOCKEVENTS
	select GENERIC_IOMAP
	select GENERIC_IRQ_CHIP
	select GENERIC_IRQ_PROBE
	select GENERIC_IRQ_SHOW
	select GENERIC_STRNCPY_FROM_USER
	select GENERIC_STRNLEN_USER
	select GENERIC_TIME_VSYSCALL
	select HAVE_ARCH_TRACEHOOK
	select HAVE_GENERIC_IOMAP
	select HAVE_DEBUG_KMEMLEAK
	select HAVE_IDE
	select HAVE_MEMBLOCK
	select HAVE_MEMBLOCK_NODE_MAP
	select HAVE_UID16
	select HAVE_REGS_AND_STACK_ACCESS_API
	select IRQ_DOMAIN
	select LOCKDEP_SUPPORT
	select MODULES_USE_ELF_REL
	select MODULES_USE_ELF_RELA
	select OF
	select OF_EARLY_FLATTREE
	select OLD_SIGACTION
	select OLD_SIGSUSPEND3
	select NO_IOPORT_MAP
	select RTC_LIB
	select THREAD_INFO_IN_TASK
	select SYS_SUPPORTS_APM_EMULATION
	help
	  Andes(nds32) Linux support.

config GENERIC_CALIBRATE_DELAY
	def_bool y

config GENERIC_CSUM
        def_bool y

config GENERIC_HWEIGHT
        def_bool y

config GENERIC_LOCKBREAK
        def_bool y
	depends on PREEMPT

config RWSEM_GENERIC_SPINLOCK
	def_bool y

config TRACE_IRQFLAGS_SUPPORT
	def_bool y

config STACKTRACE_SUPPORT
        def_bool y

config PGTABLE_LEVELS
	default 2

source "init/Kconfig"

menu "System Type"
source "arch/nds32/Kconfig.cpu"
config NR_CPUS
	int
	default 1

config MMU
        def_bool y

config NDS32_BUILTIN_DTB
        string "Builtin DTB"
        default ""
	help
	  User can use it to specify the dts of the SoC
endmenu

menu "Kernel Features"
source "kernel/Kconfig.preempt"
source "mm/Kconfig"
source "kernel/Kconfig.hz"
endmenu

menu "Executable file formats"
source "fs/Kconfig.binfmt"
endmenu

source "net/Kconfig"
source "drivers/Kconfig"
source "fs/Kconfig"
source "arch/nds32/Kconfig.debug"
source "security/Kconfig"
source "crypto/Kconfig"
source "lib/Kconfig"
```

## arch/nds32/Kconfig.cpu
```kconfig
comment "Processor Features"

config CPU_BIG_ENDIAN
	bool "Big endian"
	def_bool n

config CPU_LITTLE_ENDIAN
	bool "Little endian"
	def_bool y

config HWZOL
	bool "hardware zero overhead loop support"
	default y
	help
	  A set of Zero-Overhead Loop mechanism is provided to reduce the
	  instruction fetch and execution overhead of loop-control instructions.
	  It will save 3 registers($LB, $LC, $LE) for context saving if say Y.
	  You don't need to save these registers if you can make sure your user
	  program doesn't use these registers.

	  If unsure, say N.

config CPU_CACHE_NONALIASING
	bool "Non-aliasing cache"
	help
	  If this CPU is using VIPT data cache and its cache way size is larger
	  than page size, say N. If it is using PIPT data cache, say Y.

	  If unsure, say Y.

choice
	prompt "Paging -- page size "
	default ANDES_PAGE_SIZE_4KB
config  ANDES_PAGE_SIZE_4KB
	bool "use 4KB page size"
config  ANDES_PAGE_SIZE_8KB
	bool "use 8KB page size"
endchoice

config CPU_ICACHE_DISABLE
	bool "Disable I-Cache"
	help
	  Say Y here to disable the processor instruction cache. Unless
	  you have a reason not to or are unsure, say N.

config CPU_DCACHE_DISABLE
	bool "Disable D-Cache"
	help
	  Say Y here to disable the processor data cache. Unless
	  you have a reason not to or are unsure, say N.

config CPU_DCACHE_WRITETHROUGH
	bool "Force write through D-cache"
	depends on !CPU_DCACHE_DISABLE
	help
	  Say Y here to use the data cache in writethrough mode. Unless you
	  specifically require this or are unsure, say N.

config WBNA
	bool "WBNA"
	default n
	help
	  Say Y here to enable write-back memory with no-write-allocation policy.

config ALIGNMENT_TRAP
	bool "Kernel support unaligned access handling"
	depends on PROC_FS
	default n
	help
	  Andes processors cannot fetch/store information which is not
	  naturally aligned on the bus, i.e., a 4 byte fetch must start at an
	  address divisible by 4. On 32-bit Andes processors, these non-aligned
	  fetch/store instructions will be emulated in software if you say
	  here, which has a severe performance impact. This is necessary for
	  correct operation of some network protocols. With an IP-only
	  configuration it is safe to say N, otherwise say Y.

config HIGHMEM
	bool "High Memory Support"
	depends on MMU && CPU_CACHE_NONALIASING
	help
	  The address space of Andes processors is only 4 Gigabytes large
	  and it has to accommodate user address space, kernel address
	  space as well as some memory mapped IO. That means that, if you
	  have a large amount of physical memory and/or IO, not all of the
	  memory can be "permanently mapped" by the kernel. The physical
	  memory that is not permanently mapped is called "high memory".

	  Depending on the selected kernel/user memory split, minimum
	  vmalloc space and actual amount of RAM, you may not need this
	  option which should result in a slightly faster kernel.

	  If unsure, say N.

config CACHE_L2
	bool "Support L2 cache"
        default y
	help
	  Say Y here to enable L2 cache if your SoC are integrated with L2CC.
	  If unsure, say N.

menu "Memory configuration"

choice
	prompt "Memory split"
	depends on MMU
	default VMSPLIT_3G
	help
	  Select the desired split between kernel and user memory.

	  If you are not absolutely sure what you are doing, leave this
	  option alone!

	config VMSPLIT_3G
		bool "3G/1G user/kernel split"
	config VMSPLIT_3G_OPT
		bool "3G/1G user/kernel split (for full 1G low memory)"
	config VMSPLIT_2G
		bool "2G/2G user/kernel split"
	config VMSPLIT_1G
		bool "1G/3G user/kernel split"
endchoice

config PAGE_OFFSET
	hex
	default 0x40000000 if VMSPLIT_1G
	default 0x80000000 if VMSPLIT_2G
	default 0xB0000000 if VMSPLIT_3G_OPT
	default 0xC0000000

endmenu
```

## arch/nds32/Kconfig.debug
```kconfig
menu "Kernel hacking"

source "lib/Kconfig.debug"

config EARLY_PRINTK
        bool "Early printk support"
        default y
        help
          Say Y here if you want to have an early console using the
          earlyprintk=<name>[,<addr>][,<options>] kernel parameter. It
          is assumed that the early console device has been initialised
          by the boot loader prior to starting the Linux kernel.

endmenu
```
